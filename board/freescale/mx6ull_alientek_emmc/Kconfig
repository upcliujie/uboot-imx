## board/freescale/mx6ull_alientek_emmc/Kconfig
```kconfig
if TARGET_MX6ULL_14X14_EVK || TARGET_MX6ULL_9X9_EVK

config SYS_BOARD
	default "mx6ull_alientek_emmc"

config SYS_VENDOR
	default "freescale"

config SYS_CONFIG_NAME
	default "mx6ull_alientek_emmc"

config IMX_CONFIG
	default "board/freescale/mx6ull_alientek_emmc/imximage.cfg"

config TEXT_BASE
	default 0x87800000
endif
```
